## kbd/zmk-mcp3204/boards/shields/mcp3204/Kconfig.defconfig
```kconfig
if SHIELD_MCP3204

    config ZMK_KEYBOARD_NAME
        default "MCP3204"

    config ZMK_BLE
        bool
        default y

endif
```

## kbd/zmk-mcp3204/boards/shields/mcp3204/Kconfig.shield
```kconfig
# No whitespace after the comma or in your keyboard name!
config SHIELD_MCP3204
    def_bool $(shields_list_contains,mcp3204)
```

## kbd/zmk-mcp3204/zmk-modules/zmk-mcp3204-input-driver/Kconfig
```kconfig
menuconfig ZMK_MCP3204_INPUT
    bool "Enable MCP3204 analog input driver"
    default y
    help
      Enable support for MCP3204 as analog pointing input over SPI.
```

## kbd/zmk-mcp3204/zmk-modules/zmk-mcp3204-input-driver/dts/bindings/zmk,mcp3204-input.yaml
```yaml
description: ZMK MCP3204 analog input driver

compatible: "zmk,mcp3204-input"

include: spi-device.yaml

properties:
  x_ch:
    type: phandle
    required: false
  y_ch:
    type: phandle
    required: false
  scroll_ch:
    type: phandle
    required: false
```

## kbd/zmk-shift-reg/config/boards/shields/shift-reg/Kconfig.defconfig
```kconfig
# Copyright (c) 2020 The ZMK Contributors
# SPDX-License-Identifier: MIT

if SHIFT_REG

config ZMK_KEYBOARD_NAME
    default "shiftreg"

if ZMK_BACKLIGHT

config LED_GPIO
    default y

endif # ZMK_BACKLIGHT

endif
```

## kbd/zmk-shift-reg/config/boards/shields/shift-reg/Kconfig.shield
```kconfig
# Copyright (c) 2020 The ZMK Contributors
# SPDX-License-Identifier: MIT

config SHIFT_REG
    def_bool $(shields_list_contains,shift-reg)
    select SPI
```
